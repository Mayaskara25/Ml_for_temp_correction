/*
  temp_correction_esp32.ino
  -------------------------
  Runs a TFLite Micro Dense model via EloquentTinyML v2.4.4 on a generic ESP32
  to correct K-Type thermocouple lag using a trained ML model.

  LIBRARY SETUP (Arduino IDE):
    Board Manager : "esp32 by Espressif Systems"  (any version >= 2.0)
    Board         : "ESP32 Dev Module"
    Library       : "EloquentTinyML" by Simone Salerno  v2.4.4

  SKETCH FOLDER MUST CONTAIN:
    temp_correction_esp32.ino
    model_data.h              ← generated by train_dense_esp32.py

  NOTES ON EloquentTinyML v2.4.4 API:
    - Headers are <EloquentTinyML.h> and <eloquent_tinyml/tensorflow.h>
    - Class is Eloquent::TinyML::TensorFlow::TensorFlow<INPUTS, OUTPUTS, ARENA_BYTES>
    - begin() returns bool; isOk()/getErrorMessage() expose details
    - predict() returns output[0] and can also fill an output buffer
*/

#include <Arduino.h>
#include <EloquentTinyML.h>       // EloquentTinyML v2.4.4
#include <eloquent_tinyml/tensorflow.h>
#include "model_data.h"           // Generated C++ header from Python

// ---------------------------------------------------------------------------
// Model configuration — must match training
// ---------------------------------------------------------------------------
#define NUMBER_OF_INPUTS   10     // LOOKBACK window
#define NUMBER_OF_OUTPUTS  1      // Single corrected temperature (scaled)

// Tensor arena: Dense model is tiny; 4 KB is sufficient.
// If you see "AllocateTensors() failed", increase this in steps of 1024.
#define TENSOR_ARENA_SIZE  4096

// ---------------------------------------------------------------------------
// EloquentTinyML engine (v2.4.4 template API)
// ---------------------------------------------------------------------------
Eloquent::TinyML::TensorFlow::TensorFlow<NUMBER_OF_INPUTS, NUMBER_OF_OUTPUTS, TENSOR_ARENA_SIZE> ml;

// ---------------------------------------------------------------------------
// Normalization — MUST match T_MIN / T_MAX in the Python training script
// ---------------------------------------------------------------------------
static const float T_MIN = 20.0f;
static const float T_MAX = 80.0f;

inline float scale_temp(float t) {
    return (t - T_MIN) / (T_MAX - T_MIN);
}

inline float unscale_temp(float s) {
    return s * (T_MAX - T_MIN) + T_MIN;
}

// ---------------------------------------------------------------------------
// Rolling input buffer — oldest sample at index 0, newest at index 9
// ---------------------------------------------------------------------------
float input_buffer[NUMBER_OF_INPUTS];

// ---------------------------------------------------------------------------
// Timing
// ---------------------------------------------------------------------------
static unsigned long previousMillis = 0;
static const unsigned long INTERVAL_MS = 500;   // 2 Hz

// Synthetic signal state
static float fake_time = 0.0f;

// ---------------------------------------------------------------------------
void setup() {
    Serial.begin(115200);
    while (!Serial) { delay(10); }

    Serial.println("[BOOT] Initialising TFLite model...");

    // begin() loads and allocates the model; returns false on failure
    if (!ml.begin(model_data)) {
        Serial.println("[ERROR] ml.begin() failed!");
        Serial.print("        ");
        Serial.println(ml.getErrorMessage());
        Serial.println("        Possible causes:");
        Serial.println("        1. TENSOR_ARENA_SIZE too small — increase it.");
        Serial.println("        2. model_data[] is corrupt — re-run Python script.");
        Serial.println("        3. Unsupported op in model — ensure you used the");
        Serial.println("           Dense-only training script (no LSTM/GRU).");
        // Halt
        while (true) { delay(1000); }
    }

    Serial.println("[OK]   Model loaded successfully.");
    Serial.println("Timestamp_ms,Live_K_Temp_C,Synthetic_K_Temp_C,Live_PT100_Temp_C,Synthetic_PT100_Temp_C,Corrected_Temp_C,K_Sensor_OK,PT100_Sensor_OK");

    // Pre-fill buffer with a neutral starting value so early predictions
    // are not polluted by zero-padding
    float neutral = scale_temp(25.0f);
    for (int i = 0; i < NUMBER_OF_INPUTS; i++) {
        input_buffer[i] = neutral;
    }
}

// ---------------------------------------------------------------------------
void loop() {
    unsigned long now = millis();
    if (now - previousMillis < INTERVAL_MS) return;
    previousMillis = now;

    fake_time += 0.5f;   // Advance synthetic time by 0.5 s each tick (2 Hz)

    // ------------------------------------------------------------------
    // 1. Generate synthetic temperatures
    //    PT100  : "true" temperature  — sine wave 30–50 °C
    //    K-Type : cheap sensor — same wave but phase-lagged + bias + noise
    // ------------------------------------------------------------------
    float pt100_temp = 40.0f + 10.0f * sinf(fake_time / 10.0f);

    // random() returns long; cast to float before dividing
    float noise      = (float)random(-10, 11) / 100.0f;   // ±0.10 °C
    float k_temp     = 40.0f + 10.0f * sinf((fake_time - 2.0f) / 10.0f)
                       + 0.6f + noise;

    // ------------------------------------------------------------------
    // 2. Shift rolling buffer left, append newest scaled K-Type reading
    // ------------------------------------------------------------------
    for (int i = 0; i < NUMBER_OF_INPUTS - 1; i++) {
        input_buffer[i] = input_buffer[i + 1];
    }
    input_buffer[NUMBER_OF_INPUTS - 1] = scale_temp(k_temp);

    // ------------------------------------------------------------------
    // 3. Run inference
    // ------------------------------------------------------------------
    float corrected_scaled = ml.predict(input_buffer);
    if (!ml.isOk()) {
        Serial.println("[ERROR] ml.predict() failed — skipping sample.");
        Serial.print("        ");
        Serial.println(ml.getErrorMessage());
        return;
    }

    // ------------------------------------------------------------------
    // 4. Denormalise output
    // ------------------------------------------------------------------
    float corrected_temp = unscale_temp(corrected_scaled);

    // ------------------------------------------------------------------
    // 5. Print canonical CSV line for GUI/logger compatibility
    // ------------------------------------------------------------------
    Serial.print(now);
    Serial.print(",");
    Serial.print(k_temp, 2);
    Serial.print(",");
    Serial.print(k_temp, 2);
    Serial.print(",");
    Serial.print(pt100_temp, 2);
    Serial.print(",");
    Serial.print(pt100_temp, 2);
    Serial.print(",");
    Serial.print(corrected_temp, 2);
    Serial.print(",");
    Serial.print("1");
    Serial.print(",");
    Serial.println("1");
}
